# file: stm32-baremetal-uart-timer.ioc
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Mcu.Family=STM32L0
Mcu.Name=STM32L073R(B-Z)Tx
Mcu.Package=LQFP64
ProjectManager.HeapSize=0x200
ProjectManager.StackSize=0x400
ProjectManager.TargetToolchain=STM32CubeIDE
RCC.AHBFreq_Value=2097000
RCC.APB1Freq_Value=2097000
RCC.APB1TimFreq_Value=2097000
RCC.APB2Freq_Value=2097000
RCC.APB2TimFreq_Value=2097000
RCC.HSE_VALUE=8000000
RCC.HSI16_VALUE=16000000
RCC.HSI48_VALUE=48000000
RCC.HSI_VALUE=16000000
RCC.LSE_VALUE=32768
RCC.MSI_VALUE=2097000
RCC.SYSCLKFreq_VALUE=2097000
RCC.VCOOutputFreq_Value=48000000
board=custom

// file: Core/Src/main.c
/* USER CODE BEGIN Header */
/**
  ******************************************************************************
  * @file           : main.c
  * @brief          : Main program body
  ******************************************************************************
  * @attention
  *
  * Copyright (c) 2026 STMicroelectronics.
  * All rights reserved.
  *
  * This software is licensed under terms that can be found in the LICENSE file
  * in the root directory of this software component.
  * If no LICENSE file comes with this software, it is provided AS-IS.
  *
  ******************************************************************************
  */
/* USER CODE END Header */
#include "main.h"

void SystemClock_Config(void);

int main(void)
{

  /* MCU Configuration--------------------------------------------------------*/

  /* Reset of all peripherals, Initializes the Flash interface and the Systick. */
  HAL_Init();

  /* Configure the system clock */
  SystemClock_Config();

  /* Initialize all configured peripherals */

  /* Infinite loop */
  /* USER CODE BEGIN WHILE */
  RCC-> IOPENR |= (1<<0) | (1<<2);
//przycisk
  RCC-> APB2ENR |= (1<<0);
  SYSCFG->EXTICR[3] &= ~(15<<4);
  SYSCFG->EXTICR[3] |= (2<<4);
  EXTI->IMR |= (1<<13);
  EXTI->FTSR |= (1<<13);
  NVIC_EnableIRQ(EXTI4_15_IRQn);
//duza mala litera
  RCC->APB1ENR |= (1<<17);

  GPIOC->MODER &= ~(3<<26);

  GPIOA->MODER &= ~(3<<10);
  GPIOA->MODER |= (1<<10);
  GPIOA->MODER &= ~(3<<4);
  GPIOA->MODER |= (2<<4);

  GPIOA->MODER &= ~(3<<6);
  GPIOA->MODER |= (2<<6);

  GPIOA->AFR[0] &= ~(15<<8);
  GPIOA->AFR[0] |= (4<<8);

  GPIOA->AFR[0] &= ~(15<<12);
  GPIOA->AFR[0] |= (4<<12);

  USART2->BRR = 2097000/115200;
  USART2->CR1 |= (1<<0) | (1<<3) | (1<<2);
//zegar
  RCC->APB1ENR |= (1<<0);
  NVIC_EnableIRQ(TIM2_IRQn);
  TIM2->CR1 |=(1<<0);
  TIM2->DIER |=(1<<0);
  TIM2->PSC = 2096;
  TIM2->ARR =499;
  while (1)
  {
    /* USER CODE END WHILE */

    /* USER CODE BEGIN 3 */
	  if((USART2->ISR & (1<<5))!=0){
		  GPIOA->ODR ^= (1<<5);
		  char odebrany_znak = USART2->RDR;
		  USART2->TDR = odebrany_znak;
		  if (odebrany_znak >= 'a' && odebrany_znak <= 'z') {
		  	  odebrany_znak = odebrany_znak - 32;
		  }
		  else if (odebrany_znak >= 'A' && odebrany_znak <= 'Z') {
		      odebrany_znak = odebrany_znak + 32;
		  }
		  USART2->TDR = odebrany_znak;
		  while((USART2->ISR & (1<<7))==0){
		  }
	  }
  }
  /* USER CODE END 3 */
  /* USER CODE END 3 */
}

void SystemClock_Config(void)
{
  RCC_OscInitTypeDef RCC_OscInitStruct = {0};
  RCC_ClkInitTypeDef RCC_ClkInitStruct = {0};

  /** Configure the main internal regulator output voltage
  */
  __HAL_PWR_VOLTAGESCALING_CONFIG(PWR_REGULATOR_VOLTAGE_SCALE1);

  /** Initializes the RCC Oscillators according to the specified parameters
  * in the RCC_OscInitTypeDef structure.
  */
  RCC_OscInitStruct.OscillatorType = RCC_OSCILLATORTYPE_MSI;
  RCC_OscInitStruct.MSIState = RCC_MSI_ON;
  RCC_OscInitStruct.MSICalibrationValue = 0;
  RCC_OscInitStruct.MSIClockRange = RCC_MSIRANGE_5;
  RCC_OscInitStruct.PLL.PLLState = RCC_PLL_NONE;
  if (HAL_RCC_OscConfig(&RCC_OscInitStruct) != HAL_OK)
  {
    Error_Handler();
  }

  /** Initializes the CPU, AHB and APB buses clocks
  */
  RCC_ClkInitStruct.ClockType = RCC_CLOCKTYPE_HCLK|RCC_CLOCKTYPE_SYSCLK
                              |RCC_CLOCKTYPE_PCLK1|RCC_CLOCKTYPE_PCLK2;
  RCC_ClkInitStruct.SYSCLKSource = RCC_SYSCLKSOURCE_MSI;
  RCC_ClkInitStruct.AHBCLKDivider = RCC_SYSCLK_DIV1;
  RCC_ClkInitStruct.APB1CLKDivider = RCC_HCLK_DIV1;
  RCC_ClkInitStruct.APB2CLKDivider = RCC_HCLK_DIV1;

  if (HAL_RCC_ClockConfig(&RCC_ClkInitStruct, FLASH_LATENCY_0) != HAL_OK)
  {
    Error_Handler();
  }
}

/* USER CODE BEGIN 4 */
void EXTI4_15_IRQHandler(void){
	if(EXTI->PR & (1<<13)){
		GPIOA->ODR ^= (1<<5);
		USART2->TDR = 'X';
		while((USART2->ISR & (1<<7))==0){
		}
		EXTI->PR |= (1<<13);
	}
}

void TIM2_IRQHandler(void){
	if((TIM2->SR & (1<<0))){
		TIM2->SR &= ~(1<<0);
		GPIOA->ODR ^= (1<<5);
	}
}
/* USER CODE END 4 */

void Error_Handler(void)
{
  __disable_irq();
  while (1)
  {
  }
}
